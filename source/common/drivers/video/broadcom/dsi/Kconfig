## source/common/drivers/video/broadcom/dsi/Kconfig
```kconfig
config FB_BRCM_DSI
	tristate "Broadcom DSI Platform Framebuffer support"
    default N
	help
	  This framebuffer device driver is for the Broadcom DSI interface.
```

## source/modules/drivers/char/brcm/camacq/Kconfig
```kconfig
config VIDEO_CAMACQ
	tristate "Camacq sensor support"
	depends on I2C
	depends on BRCM_MODULES && BRCM_MODULES_PRIV
	default y
	---help---
	  This is I2c and a Video4Linux2 sensor-level driver for the camacq.
	  
config BCM_DUAL_CAM
	tristate "dual sensor support"
	depends on I2C
	depends on VIDEO_CAMACQ
	default N
	---help---
	  This is I2c and dual camera driver for the camacq.
	  
config BCM_SINGLE_CAM
	tristate "single sensor support"
	depends on I2C
	depends on VIDEO_CAMACQ
	default N
	---help---
	  This is I2c and single camera driver for the camacq.
```
